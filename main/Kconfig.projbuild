## main/Kconfig.projbuild
```kconfig
menu "Application Configuration"

	config GPIO_RANGE_MAX
		int
		default 33 if IDF_TARGET_ESP32
		default 46 if IDF_TARGET_ESP32S2
		default 48 if IDF_TARGET_ESP32S3
		default 18 if IDF_TARGET_ESP32C2
		default 19 if IDF_TARGET_ESP32C3
		default 30 if IDF_TARGET_ESP32C6

	menu "Network Setting"

		config ESP_WIFI_SSID
			string "WiFi SSID"
			default "myssid"
			help
				SSID (network name) to connect to.

		config ESP_WIFI_PASSWORD
			string "WiFi Password"
			default "mypassword"
			help
				WiFi password (WPA or WPA2) to connect to.

		config ESP_MAXIMUM_RETRY
			int "Maximum retry"
			default 5
			help
				Set the Maximum retry to avoid station reconnecting to the AP unlimited when the AP is really inexistent.


		config BROKER_URL
			string "Broker URL"
			default "mqtt://broker.emqx.io"
			help
				URL of the broker to connect to

		config MQTT_TOPIC
			string "Subscribe Topic"
			default "image/#"
			help
				Topic of subscribe

	endmenu

	menu "TFT Setting"

		choice DRIVER
			prompt "Display Driver"
			default ILI9341
			help
				Select Display Driver.
			config ILI9225
				bool "ILI9225"
				help
					Display Driver is ILI9225.
			config ILI9225G
				bool "ILI9225G"
				help
					Display Driver is ILI9225G.
			config ILI9340
				bool "ILI9340"
				help
					Display Driver is ILI9340.
			config ILI9341
				bool "ILI9341"
				help
					Display Driver is ILI9341.
			config ST7735
				bool "ST7735"
				help
					Display Driver is ST7735.
			config ST7796
				bool "ST7796"
				help
					Display Driver is ST7796S.
		endchoice

		config WIDTH
			int "SCREEN WIDTH"
			range 0 999
			default 320
			help
				The width resolution of the screen.

		config HEIGHT
			int "SCREEN HEIGHT"
			range 0 999
			default 240
			help
				The height resolution of the screen.

		config OFFSETX
			int "GRAM X OFFSET"
			range 0 99
			default 0
			help
				When your TFT have offset(X), set it.

		config OFFSETY
			int "GRAM Y OFFSET"
			range 0 99
			default 0
			help
				When your TFT have offset(Y), set it.

		config MOSI_GPIO
			int "MOSI GPIO number"
			range 0 46
			default 23 if IDF_TARGET_ESP32
			default 35 if IDF_TARGET_ESP32S2 || IDF_TARGET_ESP32S3
			default  0 # C3 and others
			help
				GPIO number (IOxx) to SPI MOSI.
				Some GPIOs are used for other purposes (flash connections, etc.) and cannot be used to MOSI.
				On the ESP32, GPIOs 35-39 are input-only so cannot be used as outputs.
				On the ESP32-S2, GPIO 46 is input-only so cannot be used as outputs.
	
		config SCLK_GPIO
			int "SCLK GPIO number"
			range 0 46
			default 18 if IDF_TARGET_ESP32
			default 36 if IDF_TARGET_ESP32S2 || IDF_TARGET_ESP32S3
			default  1 # C3 and others
			help
				GPIO number (IOxx) to SPI SCLK.
				Some GPIOs are used for other purposes (flash connections, etc.) and cannot be used to SCLK.
				On the ESP32, GPIOs 35-39 are input-only so cannot be used as outputs.
				On the ESP32-S2, GPIO 46 is input-only so cannot be used as outputs.

		config CS_GPIO
			int "CS GPIO number"
			range 0 46
			default 14 if IDF_TARGET_ESP32
			default 34 if IDF_TARGET_ESP32S2 || IDF_TARGET_ESP32S3
			default  2 # C3 and others
			help
				GPIO number (IOxx) to SPI CS.
				Some GPIOs are used for other purposes (flash connections, etc.) and cannot be used to CS.
				On the ESP32, GPIOs 35-39 are input-only so cannot be used as outputs.
				On the ESP32-S2, GPIO 46 is input-only so cannot be used as outputs.
	
		config DC_GPIO
			int "DC GPIO number"
			range 0 46
			default 27 if IDF_TARGET_ESP32
			default 37 if IDF_TARGET_ESP32S2 || IDF_TARGET_ESP32S3
			default  3 # C3 and others
			help
				GPIO number (IOxx) to SPI DC.
				Some GPIOs are used for other purposes (flash connections, etc.) and cannot be used to DC.
				On the ESP32, GPIOs 35-39 are input-only so cannot be used as outputs.
				On the ESP32-S2, GPIO 46 is input-only so cannot be used as outputs.
	
		config RESET_GPIO
			int "RESET GPIO number"
			range -1 46
			default 33 if IDF_TARGET_ESP32
			default 38 if IDF_TARGET_ESP32S2 || IDF_TARGET_ESP32S3
			default  4 # C3 and others
			help
				GPIO number (IOxx) to RESET.
				When it is -1, the RESET isn't performed.
				Some GPIOs are used for other purposes (flash connections, etc.) and cannot be used to RESET.
				On the ESP32, GPIOs 35-39 are input-only so cannot be used as outputs.
				On the ESP32-S2, GPIO 46 is input-only so cannot be used as outputs.

		config BL_GPIO
			int "BACKLIGHT GPIO number"
			range -1 46
			default 32 if IDF_TARGET_ESP32
			default 39 if IDF_TARGET_ESP32S2 || IDF_TARGET_ESP32S3
			default  5 # C3 and others
			help
				GPIO number (IOxx) to BACKLIGHT.
				When it is -1, BACKLIGHT isn't performed.
				Some GPIOs are used for other purposes (flash connections, etc.) and cannot be used to BACKLIGHT.
				On the ESP32, GPIOs 35-39 are input-only so cannot be used as outputs.
				On the ESP32-S2, GPIO 46 is input-only so cannot be used as outputs.

		config INVERSION
			bool "Enable Display Inversion"
			default false
			help
				Enable Display Inversion.
	
		config RGB_COLOR
			bool "Change BGR filter to RGB filter"
			default false
			help
				Change BGR color filter to RGB color filter
	
	endmenu

endmenu
```

## sdkconfig.defaults
```kconfig
#
# Serial flasher config
#
#CONFIG_ESPTOOLPY_FLASHFREQ_80M=y
#CONFIG_ESPTOOLPY_FLASHSIZE_4MB=y

#
# ESP System Settings
#
#CONFIG_ESP_MAIN_TASK_STACK_SIZE=8192

#
# Partition Table
#
CONFIG_PARTITION_TABLE_CUSTOM=y
CONFIG_PARTITION_TABLE_CUSTOM_FILENAME="partitions.csv"
CONFIG_PARTITION_TABLE_FILENAME="partitions.csv"

#
# ESP32-specific
#
CONFIG_ESP32_DEFAULT_CPU_FREQ_240=y
CONFIG_ESP32_DEFAULT_CPU_FREQ_MHZ=240

#
# ESP32S2-specific
#
CONFIG_ESP32S2_DEFAULT_CPU_FREQ_240=y
CONFIG_ESP32S2_DEFAULT_CPU_FREQ_MHZ=240

#
# ESP32S3-specific
#
CONFIG_ESP32S3_DEFAULT_CPU_FREQ_240=y
CONFIG_ESP32S3_DEFAULT_CPU_FREQ_MHZ=240
```
